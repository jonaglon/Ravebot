/* __                 _           _               __ _       _     _  
  /__\ __ ___   _____| |__   ___ | |_            / /(_) __ _| |__ | |_ ___
 / \/// _` \ \ / / _ \ '_ \ / _ \| __|  _____   / / | |/ _` | '_ \| __/ __|
/ _  \ (_| |\ V /  __/ |_) | (_) | |_  |_____| / /__| | (_| | | | | |_\__ \
\/ \_/\__,_| \_/ \___|_.__/ \___/ \__|         \____/_|\__, |_| |_|\__|___/
                                                       |___/                       */
#include<Arduino.h>
#include<Keypad.h>
#include<Wire.h>
#include<FastLED.h>

// Keypad setup
char keys[4][3] = { {'1','2','3'},{'4','5','6'},{'7','8','9'},{'*','0','#'}};
byte rowPins[4] = {5, 6, 7, 8}; //connect to the row pinouts of the keypad
byte colPins[3] = {2, 3, 4}; //connect to the column pinouts of the keypad
Keypad keypad = Keypad(makeKeymap(keys), rowPins, colPins, 4, 3);

unsigned long timey;
int ticky=0;

unsigned long beatTimes[10] = {0,0,0,0,0,0,0,0,0,0};
int fakeBeatLengh = 240;

// Set by midi in to be 1-16 with beat.
short sixteenth = 0;

int mainVolume = 80; // 127 actual max but we won't exceed 100.
int currentBar = 0;
int currentGenre = 0;
int currentTrack = 0;
int dropCountdown = 0;

bool robotTalking = false;
unsigned long robotTalkingOnTime;

const int numLeds = 671;
const int numLedsAdj = (numLeds * 4) / 3;
CRGB rgbwLeds[numLedsAdj];

// NEW MIXING VARS
int nextTrack = 0;
int nextGenre = 0;
int nextMixDuration16 = 0;
int currentBpm = 0;
bool stayWithinGenre = false;
bool inTheMix = false;
bool deckASelected = true;
int currentMixerPosition = 0;

void setup() {
  delay(500);

  // Talk to Ableton via midi over USB, or debug.
  Serial.begin(9600);

  // Listen to the other arduino
  Serial2.begin(57600);
  // Talk to the other arduino
  Serial3.begin(9600);

  // Make random more random?!
  randomSeed(analogRead(0));

  pinMode(12, OUTPUT); // rgb LED Setup
  LEDS.addLeds<WS2812B, 12>(rgbwLeds, numLedsAdj);
  LEDS.setBrightness(255); // 255 max

  setMainVolume(mainVolume);
}

void loop()
{
  timey = millis();

  doKeypad();

  listenToAbleton();

  receiveFromMega();

  doLights();

}

void doKeypad()
{
  char key = keypad.getKey();  
  if (key != NO_KEY)
  {
    keypadPressed(key);
  }
}

int uptopos = 0;
int currChannel = 0;
int currTrackNum = 0;
int currValue = 0;

void resetNumber() {
  int uptopos = 0;
  int currChannel = 0;
  int currValue = 0;
  int currTrackNum = 0;
}

void keypadPressed(char key) {
  if (key == '#')
    resetNumber();
  else if (key == '*')
    resetNumber();
  else if (key == '1')
    changeNumber(1);
  else if (key == '2')
    changeNumber(2);
  else if (key == '3')
    changeNumber(3);
  else if (key == '4')
    changeNumber(4);
  else if (key == '5')
    changeNumber(5);
  else if (key == '6')
    changeNumber(6);
  else if (key == '7')
    changeNumber(7);
  else if (key == '8')
    changeNumber(8);
  else if (key == '9')
    changeNumber(9);
  else if (key == '0')
    changeNumber(0);
    
}

void changeNumber(int inNum) {
  if (uptopos == 0) {
    currChannel = (10 * inNum);
    uptopos=1;
  } else if (uptopos == 1) {
    currChannel = currChannel + inNum;
    uptopos=2;
  } else if (uptopos == 2) {
    currTrackNum =  (100 * inNum);
    uptopos=3;
  } else if (uptopos == 3) {
    currTrackNum = currTrackNum + (10 * inNum);
    uptopos=4;
  } else if (uptopos == 4) {
    currTrackNum = currTrackNum+ inNum;
    PlayAbletonTrack(currChannel, currTrackNum);
    uptopos=0;
  }
}

void changeNumberFull(int inNum) {
  if (uptopos == 0) {
    currChannel = (100 * inNum);
    uptopos=1;
  } else if (uptopos == 1) {
    currChannel = currChannel + (10 * inNum);
    uptopos=2;
  } else if (uptopos == 2) {
    currChannel =  currChannel + inNum;
    uptopos=3;
  } else if (uptopos == 3) {
    currTrackNum = 100 * inNum;
    uptopos=4;
  } else if (uptopos == 4) {
    currTrackNum = currTrackNum + (10 * inNum);
    uptopos=5;
  } else if (uptopos == 5) {
    currTrackNum = currTrackNum + inNum;
    uptopos=6;
  } else if (uptopos == 6) {
    currValue = 100 * inNum;
    uptopos=7;
  } else if (uptopos == 7) {
    currValue = currValue + (10 * inNum);
    uptopos=8;
  } else if (uptopos == 8) {
    currValue = currValue + inNum;
    sendMidi(currChannel, currTrackNum, currValue);
    uptopos=0;
  }
}

/* ************************************************************** *
 *                                                               
 *                            LED PATTERNS
 *  
 * ************************************************************** */

int tapePattern[224][2] = {
  {4,6}, {4,5}, {4,4}, {4,0}, {4,1}, {4,2}, {4,7}, {4,10}, {4,9}, {4,8}, 
  {4, 3}, {3,83}, {3,82}, {3,81}, {3,80}, {3,79}, {3,78}, {3,77}, {3,76}, {3,75},   
  {3,74}, {3,73}, {3,72}, {3,71}, {3,70}, {3,69}, {3,68}, {3,67}, {3,66}, {3,65},   
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  {0,80}, {0,79}, {0,78}, {1, 7}, {1,10}, {1, 9}, {1, 8}, {1, 3}, {1, 0}, {1, 1}, {1, 2}, {1, 6}, {1, 5}, {1, 4} };

int sweepPatterns[270][5] = {
{  0, 27,  2,  8,  6}, {  1, 30,  2, 10,  3}, {  2, 33,  3, 13,  2}, {  3, 36,  4, 17,  1}, {  4, 38,  6, 21,  1}, {  5, 39,  8, 24,  1}, {  6, 40, 10, 28,  2}, {  7, 41, 12, 31,  3},{  8, 41, 15, 34,  6},{  9, 41, 18, 36,  9},
{ 10, 40, 20, 38, 12}, { 11, 39, 22, 39, 15}, { 12, 38, 24, 39, 19}, { 13, 36, 27, 39, 23}, { 14, 33, 28, 38, 27}, { 15, 30, 29, 36, 30}, { 16, 27, 29, 34, 32}, { 17, 25, 29, 31, 35},{ 18, 23, 28, 28, 37},{ 19, 21, 27, 24, 38},
{ 20, 19, 24, 21, 38}, { 21, 17, 22, 17, 38}, { 22, 16, 20, 13, 37}, { 23, 15, 18, 10, 35}, { 24, 15, 15,  8, 32}, { 25, 15, 12,  5, 30}, { 26, 16, 10,  3, 27}, { 27, 17,  8,  2, 23},{ 28, 19,  6,  2, 19},{ 29, 21,  4,  2, 15},
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{260,  0, 49, 25, 79}, {261,  0, 51, 27, 80}, {262,  0, 53, 29, 82}, {263,  0, 55, 30, 84}, {264,  0, 57, 32, 86}, {265,  0, 58, 34, 88}, {266,  0, 60, 35, 90}, {267,  0, 62, 37, 91},{268,  0, 64, 39, 93},{269,  0, 65, 40, 95}};
 

boolean rightEyeQuartAnim [4][95] = {
{ 1, 0, 0, 0, 0, 0, 0, 0, 0, 0, 
  0, 0, 0, 0, 0, 0, 0, 0, 0, 0, 
  0, 0, 0, 0, 1, 1, 1, 1, 1, 1, 
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  1, 1, 0, 0, 0 }
};

struct tuneInfo {
  int bpm;
  int drop1;
  int drop2;
  int tuneLength;
  int minFadeIn;
  int maxFadeIn;
  int minFadeOut;
  int maxFadeOut;
  tuneInfo(int aBpm, int aDrop1, int aDrop2, int aTuneLength, int aMinFadeIn, int aMaxFadeIn, int aMinFadeOut, int aMaxFadeOut) : 
           bpm(aBpm), drop1(aDrop1), drop2(aDrop2), tuneLength(aTuneLength), minFadeIn(aMinFadeIn), maxFadeIn(aMaxFadeIn), minFadeOut(aMinFadeOut), maxFadeOut(aMaxFadeOut) { 
  }
};

int numTunesByGenre[10] = {11, 11, 11, 11, 11, 11, 11, 11, 11, 11};

tuneInfo tunesLibrary[10][11] = {
 {{103,  5, 69, 123, 0, 0, 0, 0},  // Moma said knock you out        // 0, 1   Hip-hop
  {101,  5, 25,  81, 0, 0, 0, 0},  // Lets get ill
  { 92,  2, 49, 129, 0, 0, 0, 0},  // Dre&2Pac California
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  {175,  0,  0, 170, 0, 0, 0, 0}} // PassMeTheRizla-Deekline

};




/* 

 {{000,  0,  0, 000, 0, 0, 0, 0},
  {000,  0,  0, 000, 0, 0, 0, 0},
  {000,  0,  0, 000, 0, 0, 0, 0},
  {000,  0,  0, 000, 0, 0, 0, 0},
  {000,  0,  0, 000, 0, 0, 0, 0},
  {000,  0,  0, 000, 0, 0, 0, 0},
  {000,  0,  0, 000, 0, 0, 0, 0},
  {000,  0,  0, 000, 0, 0, 0, 0},
  {000,  0,  0, 000, 0, 0, 0, 0},
  {000,  0,  0, 000, 0, 0, 0, 0}}, 
};   */ 
  
